## config/opensbi-checkpoint10.defconfig
```kconfig
CONFIG_FDT_IPI=y
CONFIG_FDT_IPI_MSWI=y
CONFIG_FDT_IRQCHIP=y
CONFIG_FDT_IRQCHIP_PLIC=y
CONFIG_FDT_SERIAL=y
CONFIG_FDT_SERIAL_UART8250=y
CONFIG_FDT_TIMER=y
CONFIG_FDT_TIMER_MTIMER=y
# CONFIG_SBI_ECALL_CPPC is not set
# CONFIG_SBI_ECALL_PMU is not set
# CONFIG_SBI_ECALL_DBTR is not set
# CONFIG_SBI_ECALL_SSE is not set
# CONFIG_SBI_ECALL_MPXY is not set
```
